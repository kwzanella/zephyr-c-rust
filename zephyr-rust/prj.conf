## CMakeLists.txt
```
cmake_minimum_required(VERSION 3.20.0)

find_package(Zephyr REQUIRED HINTS $ENV{ZEPHYR_BASE})

project(zephyr-rust)

target_sources(app PRIVATE
    src/zephyr_c_wrapper.c
)

rust_cargo_application()
```

## prj.conf
```kconfig
# The default 1k stack isn't large enough for rust string formatting with logging.
CONFIG_MAIN_STACK_SIZE=4096

CONFIG_RUST=y

CONFIG_RUST_ALLOC=y
CONFIG_LOG=y

CONFIG_LOG_BACKEND_RTT=n

CONFIG_SYS_CLOCK_TICKS_PER_SEC=1000
CONFIG_CRC=y
CONFIG_TEST_RANDOM_GENERATOR=y
CONFIG_TIMER_RANDOM_GENERATOR=y
CONFIG_TIMESLICING=y

CONFIG_SIZE_OPTIMIZATIONS_AGGRESSIVE=y
```

## src/zephyr_c_wrapper.c
```c
#include <zephyr/random/random.h>
#include <zephyr/sys/crc.h>

#include <stdint.h>
#include <stdint.h>
#include <stddef.h>

uint32_t rust_random_u32(void)
{
    return sys_rand32_get();
}

uint32_t rust_crc32(const uint8_t *data, size_t len)
{
    return crc32_ieee(data, len);
}
```
